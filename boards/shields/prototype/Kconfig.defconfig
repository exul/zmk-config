## boards/shields/prototype/Kconfig.defconfig
```kconfig
if SHIELD_PROTOTYPE_LEFT

config ZMK_KEYBOARD_NAME
    default "Prototype"

config ZMK_SPLIT_ROLE_CENTRAL
    default y

endif

if SHIELD_PROTOTYPE_LEFT || SHIELD_PROTOTYPE_RIGHT

config ZMK_SPLIT
    default y

endif
```

## boards/shields/prototype/Kconfig.shield
```kconfig
config SHIELD_PROTOTYP_LEFT
    def_bool $(shields_list_contains,prototype_left)

config SHIELD_PROTOTYPE_RIGHT
    def_bool $(shields_list_contains,prototype_right)
```

## boards/shields/prototype2/Kconfig.defconfig
```kconfig
if SHIELD_PROTOTYPE2_DONGLE

# Max 16 characters in keyboard name
config ZMK_KEYBOARD_NAME
    default "Prototype2"

config ZMK_SPLIT_ROLE_CENTRAL
    default y

config ZMK_SPLIT_BLE_CENTRAL_PERIPHERALS
    default 2

config ZMK_DISPLAY
    default y

config ZMK_SPLIT_BLE_CENTRAL_BATTERY_LEVEL_FETCHING
    default y

config BT_MAX_CONN
    default 3

config BT_MAX_PAIRED
    default 3

config ZMK_STUDIO
    default y

endif

if SHIELD_PROTOTYPE2_DONGLE || SHIELD_PROTOTYPE2_LEFT || SHIELD_PROTOTYPE2_RIGHT

config ZMK_SPLIT
    default y

endif
```

## boards/shields/prototype2/Kconfig.shield
```kconfig
config SHIELD_PROTOTYPE2_DONGLE
    def_bool $(shields_list_contains,prototype2_dongle)

config SHIELD_PROTOTYPE2_LEFT
    def_bool $(shields_list_contains,prototype2_left)

config SHIELD_PROTOTYPE2_RIGHT
    def_bool $(shields_list_contains,prototype2_right)
```

## config/west.yml
```yaml
manifest:
  remotes:
    - name: zmkfirmware
      url-base: https://github.com/zmkfirmware
    - name: janpfischer
      url-base: https://github.com/janpfischer
    - name: urob
      url-base: https://github.com/urob
  projects:
    - name: zmk
      remote: zmkfirmware
      revision: main
      import: app/west.yml
    - name: zmk-dongle-screen
      remote: janpfischer
      revision: main
    - name: zmk-adaptive-key
      remote: urob
      revision: main
  self:
    path: config
```
