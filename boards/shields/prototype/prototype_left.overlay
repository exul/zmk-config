#include "prototype.dtsi"

&kscan0 {
    row-gpios
        = <&pro_micro 9 (GPIO_ACTIVE_HIGH | GPIO_PULL_DOWN)>  // COL 0 (UPPER)
        , <&pro_micro 8 (GPIO_ACTIVE_HIGH | GPIO_PULL_DOWN)>  // COL 1 (HOME)
        , <&pro_micro 7 (GPIO_ACTIVE_HIGH | GPIO_PULL_DOWN)>  // COL 2 (LOWER)
        , <&pro_micro 6 (GPIO_ACTIVE_HIGH | GPIO_PULL_DOWN)>  // COL 3 (THUMB)
        ;

    col-gpios
        = <&pro_micro 10 GPIO_ACTIVE_HIGH> // (outer)
        , <&pro_micro 16 GPIO_ACTIVE_HIGH> // (pinky)
        , <&pro_micro 14 GPIO_ACTIVE_HIGH> // (ring)
        , <&pro_micro 15 GPIO_ACTIVE_HIGH> // (middle)
        , <&pro_micro 18 GPIO_ACTIVE_HIGH> // (index)
        , <&pro_micro 19 GPIO_ACTIVE_HIGH> // (inner)
        ;
};